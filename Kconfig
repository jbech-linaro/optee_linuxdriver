## Kconfig
```kconfig
#
# Copyright (c) 2014, STMicroelectronics International N.V.
#
# This program is free software; you can redistribute it and/or modify
# it under the terms of the GNU General Public License Version 2 as
# published by the Free Software Foundation.
#
# This program is distributed in the hope that it will be useful,
# but WITHOUT ANY WARRANTY; without even the implied warranty of
# MERCHANTABILITY or FITNESS FOR A PARTICULAR PURPOSE. See the
# GNU General Public License for more details.
#

# Trursted Execution Environment Configuration
config TEE_SUPPORT
	bool "OP-TEE driver support"
	default y
	---help---
	  This option implements the kernel driver for OP-TEE. If you want to
	  make OP-TEE working in your hardware, please say 'Yes' to configure.
	  Choose 'M' to compile this driver as a module and say 'N' if unsure.
```
